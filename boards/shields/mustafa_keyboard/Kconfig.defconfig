## boards/shields/mustafa_keyboard/Kconfig.defconfig
```kconfig
if SHIELD_MUSTAFA_KEYBOARD

config ZMK_KEYBOARD_NAME
    default "Mustafa KB"

endif
```

## boards/shields/mustafa_keyboard/Kconfig.shield
```kconfig
config SHIELD_MUSTAFA_KEYBOARD
    def_bool $(shields_list_contains,mustafa_keyboard)
```
