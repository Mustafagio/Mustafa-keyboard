#include <behaviors.dtsi>
#include <dt-bindings/zmk/keys.h>
#include <dt-bindings/zmk/bt.h>
#include "keys_tr.h"

/ {
    keymap {
        compatible = "zmk,keymap";

        // =============================================================
        // TÜRKÇE Q BASE LAYER
        // =============================================================

        base_layer {
            display-name = "Türkçe Q";

            bindings = <
                // =====================================================
                // R0
                // ESC 1 2 3 4 5 6 7 8 9 0 * - BACKSPACE
                // =====================================================

                &kp ESC

                &kp TR_N1
                &kp TR_N2
                &kp TR_N3
                &kp TR_N4
                &kp TR_N5
                &kp TR_N6
                &kp TR_N7
                &kp TR_N8
                &kp TR_N9
                &kp TR_N0

                // * ?
                &kp TR_ASTERISK

                // - _
                &kp TR_MINUS

                &kp BSPC


                // =====================================================
                // R1
                // TAB Q W E R T Y U I O P Ğ Ü ,
                // =====================================================

                &kp TAB

                &kp TR_Q
                &kp TR_W
                &kp TR_E
                &kp TR_R
                &kp TR_T
                &kp TR_Y
                &kp TR_U

                // ı
                &kp TR_I_DOTLESS

                &kp TR_O
                &kp TR_P

                // Ğ
                &kp TR_E_BREVE

                // Ü
                &kp TR_U_UMLAUT

                // ,
                &kp TR_COMMA


                // =====================================================
                // R2
                // CAPS A S D F G H J K L Ş İ ENTER
                // =====================================================

                &kp CAPSLOCK

                &kp TR_A
                &kp TR_S
                &kp TR_D
                &kp TR_F
                &kp TR_G
                &kp TR_H
                &kp TR_J
                &kp TR_K
                &kp TR_L

                // Ş
                &kp TR_S_CEDILLA

                // İ
                &kp TR_I_DOT

                &kp ENTER


                // =====================================================
                // R3
                // SHIFT Z X C V B N M Ö Ç . SHIFT UP DEL
                // =====================================================

                &kp LSHIFT

                &kp TR_Z
                &kp TR_X
                &kp TR_C
                &kp TR_V
                &kp TR_B
                &kp TR_N
                &kp TR_M

                // Ö
                &kp TR_O_UMLAUT

                // Ç
                &kp TR_C_CEDILLA

                // .
                &kp TR_PERIOD

                &kp RSHIFT

                &kp UP
                &kp DEL


                // =====================================================
                // R4
                // CTRL WIN ALT SPACE ALTGR FN LEFT DOWN RIGHT
                // =====================================================

                &kp LCTRL
                &kp LGUI
                &kp LALT
                &kp SPACE
                &kp RALT

                // FN
                &mo 1

                &kp LEFT
                &kp DOWN
                &kp RIGHT
            >;
        };


        // =============================================================
        // FN LAYER
        // =============================================================

        fn_layer {
            display-name = "FN";

            bindings = <
                // =====================================================
                // R0
                // ESC F1 F2 F3 F4 F5 F6 F7 F8 F9 F10 F11 F12 BSPC
                // =====================================================

                // FN + ESC = Soft Off
                &soft_off

                &kp F1
                &kp F2
                &kp F3
                &kp F4
                &kp F5
                &kp F6
                &kp F7
                &kp F8
                &kp F9
                &kp F10
                &kp F11
                &kp F12

                &kp BSPC


                // =====================================================
                // R1
                // 14 TUŞ
                // =====================================================

                &trans
                &trans
                &trans
                &trans
                &trans
                &trans
                &trans
                &trans
                &trans
                &trans
                &trans
                &trans
                &trans
                &trans


                // =====================================================
                // R2
                // 13 TUŞ
                // =====================================================

                &trans
                &trans
                &trans
                &trans
                &trans
                &trans
                &trans
                &trans
                &trans
                &trans
                &trans
                &trans
                &trans


                // =====================================================
                // R3
                // 14 TUŞ
                // =====================================================

                &trans
                &trans
                &trans
                &trans
                &trans
                &trans
                &trans
                &trans
                &trans
                &trans
                &trans

                // Bluetooth profil 3
                &bt BT_SEL 3

                // Bluetooth profil 4
                &bt BT_SEL 4

                &trans


                // =====================================================
                // R4
                // 9 TUŞ
                // =====================================================

                &trans
                &trans
                &trans
                &trans
                &trans

                // FN
                &mo 1

                // Bluetooth profil 0
                &bt BT_SEL 0

                // Bluetooth profil 1
                &bt BT_SEL 1

                // Bluetooth profil 2
                &bt BT_SEL 2
            >;
        };
    };
};
